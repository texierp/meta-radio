## conf/distro/radio-distro.conf
```bitbake
require conf/distro/poky.conf

DISTRO = "Monitoring"
DISTRO_NAME = "Monitoring powered by Yocto/OE"
DISTRO_VERSION="1.0+snapshot-${DATE}"

# Use systemd as init system
VIRTUAL-RUNTIME_init_manager = "systemd"
DISTRO_FEATURES_BACKFILL_CONSIDERED = "sysvinit"
VIRTUAL-RUNTIME_initscripts = ""
DISTRO_FEATURES_append = " systemd" 
```
